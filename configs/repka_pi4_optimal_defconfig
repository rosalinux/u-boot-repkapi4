## configs/repka_pi4_optimal_defconfig
```kconfig
CONFIG_ARM=y
CONFIG_ARCH_SUNXI=y
CONFIG_DEFAULT_DEVICE_TREE="sun50i-h6-repka-pi4-optimal"
CONFIG_SPL=y
CONFIG_MACH_SUN50I_H6=y
CONFIG_SUNXI_DRAM_H6_DDR3_1333=y
#CONFIG_DRAM_CLK=672
#CONFIG_DRAM_CLK=816
#CONFIG_DRAM_CLK=912
CONFIG_DRAM_CLK=936
#CONFIG_DRAM_CLK=960
#CONFIG_DRAM_CLK=984
#CONFIG_DRAM_CLK=1008
CONFIG_MMC0_CD_PIN="PF6"
CONFIG_MMC_SUNXI_SLOT_EXTRA=2
# CONFIG_SYS_MALLOC_CLEAR_ON_INIT is not set
CONFIG_PHY_SUN50I_USB3=y
CONFIG_USB_XHCI_HCD=y
CONFIG_USB_XHCI_DWC3=y
CONFIG_USB_EHCI_HCD=y
CONFIG_USB_OHCI_HCD=y
CONFIG_USB_DWC3=y
# CONFIG_USB_DWC3_GADGET is not set
# uboot logoff
#CONFIG_BOOTDELAY=-2
#CONFIG_SILENT_CONSOLE=y
#CONFIG_SYS_DEVICE_NULLDEV=y
#CONFIG_SILENT_CONSOLE_UPDATE_ON_SET=y
#CONFIG_SILENT_U_BOOT_ONLY=y
```
